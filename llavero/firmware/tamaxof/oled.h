#pragma once
// Pantalla OLED 0.96" SSD1306 128x64 por I2C, sin librerías externas.
// Todo se dibuja en buf (1 KB) y mostrar() lo manda de un jalón.
#include <Arduino.h>
#include <Wire.h>

// Fuente 5x7 clásica, de ' ' (0x20) a '~' (0x7E). Cada letra = 5 columnas, bit 0 arriba.
static const uint8_t FUENTE[] PROGMEM = {
  0x00,0x00,0x00,0x00,0x00, 0x00,0x00,0x5F,0x00,0x00, 0x00,0x07,0x00,0x07,0x00, 0x14,0x7F,0x14,0x7F,0x14,
  0x24,0x2A,0x7F,0x2A,0x12, 0x23,0x13,0x08,0x64,0x62, 0x36,0x49,0x56,0x20,0x50, 0x00,0x08,0x07,0x03,0x00,
  0x00,0x1C,0x22,0x41,0x00, 0x00,0x41,0x22,0x1C,0x00, 0x2A,0x1C,0x7F,0x1C,0x2A, 0x08,0x08,0x3E,0x08,0x08,
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  0x00,0x00,0x77,0x00,0x00, 0x00,0x41,0x36,0x08,0x00, 0x02,0x01,0x02,0x04,0x02,
};

class Oled {
 public:
  static const int W = 128, H = 64;
  uint8_t buf[W * H / 8];

  bool begin(uint8_t dir = 0x3C) {
    _dir = dir;
    Wire.beginTransmission(_dir);
    if (Wire.endTransmission() != 0) return false;
    static const uint8_t INI[] = {0xAE, 0xD5, 0x80, 0xA8, 0x3F, 0xD3, 0x00, 0x40, 0x8D, 0x14, 0x20, 0x00,
                                  0xA1, 0xC8, 0xDA, 0x12, 0x81, 0xCF, 0xD9, 0xF1, 0xDB, 0x40, 0xA4, 0xA6, 0x2E, 0xAF};
    for (uint8_t c : INI) cmd(c);
    limpiar();
    mostrar();
    return true;
  }

  void cmd(uint8_t c) { Wire.beginTransmission(_dir); Wire.write(0x00); Wire.write(c); Wire.endTransmission(); }

  void mostrar() {
    cmd(0x21); cmd(0); cmd(W - 1);
    cmd(0x22); cmd(0); cmd(H / 8 - 1);
    for (int i = 0; i < (int)sizeof buf; i += 64) {
      Wire.beginTransmission(_dir);
      Wire.write(0x40);
      Wire.write(buf + i, 64);
      Wire.endTransmission();
    }
  }

  void brillo(uint8_t b) { cmd(0x81); cmd(b); }
  // Apagada de verdad (bomba de carga también): unos µA, para el sueño profundo
  void dormir() { cmd(0xAE); cmd(0x8D); cmd(0x10); }
  void despertar() { cmd(0x8D); cmd(0x14); cmd(0xAF); }

  void limpiar() { memset(buf, 0, sizeof buf); }

  void px(int x, int y, bool on = true) {
    if ((unsigned)x >= W || (unsigned)y >= H) return;
    if (on) buf[x + (y >> 3) * W] |= 1 << (y & 7);
    else buf[x + (y >> 3) * W] &= ~(1 << (y & 7));
  }

  void rellenar(int x, int y, int w, int h, bool on = true) {
    for (int j = y; j < y + h; j++)
      for (int i = x; i < x + w; i++) px(i, j, on);
  }

  void marco(int x, int y, int w, int h, bool on = true) {
    rellenar(x, y, w, 1, on); rellenar(x, y + h - 1, w, 1, on);
    rellenar(x, y, 1, h, on); rellenar(x + w - 1, y, 1, h, on);
  }

  void linea(int x0, int y0, int x1, int y1, bool on = true) {
    int dx = abs(x1 - x0), sx = x0 < x1 ? 1 : -1, dy = -abs(y1 - y0), sy = y0 < y1 ? 1 : -1, e = dx + dy;
    for (;;) {
      px(x0, y0, on);
      if (x0 == x1 && y0 == y1) break;
      int e2 = 2 * e;
      if (e2 >= dy) { e += dy; x0 += sx; }
      if (e2 <= dx) { e += dx; y0 += sy; }
    }
  }

  void circulo(int cx, int cy, int r, bool lleno = true, bool on = true) {
    for (int y = -r; y <= r; y++)
      for (int x = -r; x <= r; x++) {
        int d = x * x + y * y;
        if (d <= r * r && (lleno || d > (r - 1) * (r - 1))) px(cx + x, cy + y, on);
      }
  }

  // Rectángulo con esquinas redondas (relleno), como los ojos
  void redondo(int x, int y, int w, int h, int r, bool on = true) {
    if (w <= 0 || h <= 0) return;
    r = min(r, min(w, h) / 2);
    rellenar(x + r, y, w - 2 * r, h, on);
    rellenar(x, y + r, r, h - 2 * r, on);
    rellenar(x + w - r, y + r, r, h - 2 * r, on);
    for (int j = 0; j < r; j++)
      for (int i = 0; i < r; i++) {
        int dx = r - i - 1, dy = r - j - 1;
        if (dx * dx + dy * dy < r * r) {
          px(x + i, y + j, on); px(x + w - 1 - i, y + j, on);
          px(x + i, y + h - 1 - j, on); px(x + w - 1 - i, y + h - 1 - j, on);
        }
      }
  }

  void triangulo(int x0, int y0, int x1, int y1, int x2, int y2, bool on = true) {
    int minY = min(y0, min(y1, y2)), maxY = max(y0, max(y1, y2));
    for (int y = minY; y <= maxY; y++) {
      int xa = 999, xb = -999;
      auto lado = [&](int ax, int ay, int bx, int by) {
        if ((y < ay && y < by) || (y > ay && y > by) || ay == by) return;
        int x = ax + (long)(y - ay) * (bx - ax) / (by - ay);
        xa = min(xa, x); xb = max(xb, x);
      };
      lado(x0, y0, x1, y1); lado(x1, y1, x2, y2); lado(x2, y2, x0, y0);
      if (xa <= xb) rellenar(xa, y, xb - xa + 1, 1, on);
    }
  }

  int letra(int x, int y, char c, uint8_t esc = 1, bool on = true) {
    if (c < 0x20 || c > 0x7E) c = '?';
    const uint8_t* g = FUENTE + (c - 0x20) * 5;
    for (int i = 0; i < 5; i++) {
      uint8_t col = pgm_read_byte(g + i);
      for (int j = 0; j < 8; j++)
        if (col & (1 << j)) rellenar(x + i * esc, y + j * esc, esc, esc, on);
    }
    return 6 * esc;
  }

  int texto(int x, int y, const char* s, uint8_t esc = 1, bool on = true) {
    while (*s) x += letra(x, y, *s++, esc, on);
    return x;
  }

  static int ancho(const char* s, uint8_t esc = 1) { return strlen(s) * 6 * esc - esc; }
  void centrado(int y, const char* s, uint8_t esc = 1, bool on = true) { texto((W - ancho(s, esc)) / 2, y, s, esc, on); }

  // Barra de avance 0..1
  void barra(int x, int y, int w, int h, float v) {
    marco(x, y, w, h);
    int lleno = constrain((int)((w - 4) * v), 0, w - 4);
    rellenar(x + 2, y + 2, lleno, h - 4);
  }

 private:
  uint8_t _dir = 0x3C;
};
